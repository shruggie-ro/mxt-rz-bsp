## build/conf/bblayers.conf
```bitbake
# POKY_BBLAYERS_CONF_VERSION is increased each time build/conf/bblayers.conf
# changes incompatibly
POKY_BBLAYERS_CONF_VERSION = "2"

BBPATH = "${TOPDIR}"
BBFILES ?= ""

BBLAYERS ?= " \
  ${TOPDIR}/../poky/meta \
  ${TOPDIR}/../poky/meta-poky \
  ${TOPDIR}/../poky/meta-yocto-bsp \
  ${TOPDIR}/../meta-openembedded/meta-oe \
  ${TOPDIR}/../meta-openembedded/meta-python \
  ${TOPDIR}/../meta-openembedded/meta-multimedia \
  ${TOPDIR}/../meta-mxt/meta-rz-common \
  ${TOPDIR}/../meta-mxt/meta-rzg2l \
  ${TOPDIR}/../meta-mxt/meta-rzv2l \
  "
```

## meta-mxt/meta-rz-common/conf/layer.conf
```bitbake
# We have a conf and classes directory, add to BBPATH
BBPATH .= ":${LAYERDIR}"

# We have recipes-* directories, add to BBFILES
BBFILES += "${LAYERDIR}/recipes-*/*/*.bb \
	    ${LAYERDIR}/recipes-*/*/*.bbappend"

BBFILE_COLLECTIONS += "rz-common"
BBFILE_PATTERN_rz-common = "^${LAYERDIR}/"
BBFILE_PRIORITY_rz-common = "15"

LAYERDEPENDS_rz-common = "core yocto yoctobsp openembedded-layer"
LAYERSERIES_COMPAT_rz-common = "scarthgap"

HOSTTOOLS += "xz"
```

## meta-mxt/meta-rzg2l/conf/machine/smarc-rzg2l.conf
```bitbake
#@TYPE: Machine
#@NAME: smarc-rzg2l machine
#@DESCRIPTION: RZ/G2L SMARC platform

SOC_FAMILY = "r9a07g044l"
require conf/machine/include/rz-common.inc
require conf/machine/include/arm/armv8-2a/tune-cortexa55.inc

DEFAULTTUNE ?= "cortexa55"

PREFERRED_PROVIDER_virtual/kernel="linux-cip"

UBOOT_CONFIG ??= "smarc-rzg2l"
UBOOT_CONFIG[smarc-rzg2l] = "smarc-rzg2l_defconfig"

# flash writer
EXTRA_IMAGEDEPENDS += " flash-writer"

# Support board with PMIC. Default:yes.
# With this option enabled, build both bin files for PMIC board and Concrete board.
PMIC_SUPPORT ?= "1"

# Supported devicetree
KERNEL_DEVICETREE = " \
	renesas/r9a07g044l2-smarc.dtb \
"
```

## meta-mxt/meta-rzv2l/conf/machine/smarc-rzv2l.conf
```bitbake
#@TYPE: Machine
#@NAME: vision-ai-rzv2l machine
#@DESCRIPTION: RZ/V2L SMARC

require conf/machine/smarc-rzg2l.conf
```

## meta-mxt/meta-rzv2l/conf/machine/vision-ai-rzv2l.conf
```bitbake
#@TYPE: Machine
#@NAME: rzv2l-vision-ai machine
#@DESCRIPTION: RZ/V2L Vision AI

require conf/machine/smarc-rzg2l.conf
```
